## sdkconfig.defaults
```kconfig
### changed by Marcus A. P. Oliveira###
CONFIG_ESP_TASK_WDT_CHECK_IDLE_TASK_CPU0=n
CONFIG_ESP_TASK_WDT_PANIC=n

#CONFIG_SPI_FLASH_SHARE_SPI1_BUS=y

CONFIG_PCNT_SUPPRESS_DEPRECATE_WARN=y
CONFIG_LOG_MASTER_LEVEL=y

CONFIG_PM_ENABLE=y

CONFIG_PPP_SUPPORT=y
CONFIG_LWIP_PPP_PAP_SUPPORT=y
CONFIG_LWIP_PPP_CHAP_SUPPORT=n
CONFIG_LWIP_PPP_DEBUG_ON=n
CONFIG_LWIP_PPP_NOTIFY_PHASE_SUPPORT=m

# Enable ULP
CONFIG_ULP_COPROC_ENABLED=y
CONFIG_ULP_COPROC_TYPE_FSM=y
CONFIG_ULP_COPROC_RESERVE_MEM=1024
# Set log level to Warning to produce clean output
CONFIG_BOOTLOADER_LOG_LEVEL_WARN=y
CONFIG_BOOTLOADER_LOG_LEVEL=2
CONFIG_LOG_DEFAULT_LEVEL_WARN=y
CONFIG_LOG_DEFAULT_LEVEL=5
CONFIG_LOG_MAXIMUM_LEVEL=4
CONFIG_BOOTLOADER_SKIP_VALIDATE_IN_DEEP_SLEEP=y
#########################



CONFIG_NEWLIB_ENABLE=y
CONFIG_NEWLIB_LIBRARY_LEVEL_NORMAL=y
CONFIG_NEWLIB_NANO_FORMAT=
CONFIG_SSL_USING_MBEDTLS=y
CONFIG_LWIP_IPV6=y
CONFIG_MBEDTLS_THREADING_C=y
# CONFIG_MBEDTLS_THREADING_ALT is not set
CONFIG_MBEDTLS_THREADING_PTHREAD=y
CONFIG_PTHREAD_TASK_STACK_SIZE_DEFAULT=8192
CONFIG_PARTITION_TABLE_CUSTOM=y
CONFIG_PARTITION_TABLE_CUSTOM_FILENAME="partitions_ota_mqtt.csv"
CONFIG_PARTITION_TABLE_FILENAME="partitions_ota_mqtt.csv"
CONFIG_ESPTOOLPY_FLASHSIZE_4MB=y
CONFIG_BOOTLOADER_APP_ROLLBACK_ENABLE=y
CONFIG_MBEDTLS_CMAC_C=y
CONFIG_OTA_DATA_OVER_MQTT=y
CONFIG_OTA_DATA_OVER_HTTP=n
CONFIG_OTA_DATA_OVER_MQTT_PRIMARY=y
CONFIG_OTA_DATA_OVER_HTTP_PRIMARY=n
CONFIG_ESP32_COMPATIBLE_PRE_V3_1_BOOTLOADERS=y
CONFIG_ESP_SYSTEM_EVENT_TASK_STACK_SIZE=5000

CONFIG_ESP_MAIN_TASK_STACK_SIZE=9000

CONFIG_EXAMPLE_CONNECT_IPV6=n

# Enable TLS asymmetric in/out content length
CONFIG_MBEDTLS_ASYMMETRIC_CONTENT_LEN=y
CONFIG_MBEDTLS_SSL_IN_CONTENT_LEN=16384
CONFIG_MBEDTLS_SSL_OUT_CONTENT_LEN=4096

# # Allow to use dynamic buffer strategy for mbedTLS
# CONFIG_MBEDTLS_DYNAMIC_BUFFER=y
# CONFIG_MBEDTLS_DYNAMIC_FREE_PEER_CERT=y
# CONFIG_MBEDTLS_DYNAMIC_FREE_CONFIG_DATA=y

# CONFIG_ESP_TASK_WDT_EN=n

#
# FAT Filesystem support
#
CONFIG_FATFS_LFN_STACK=y 
CONFIG_FATFS_MAX_LFN=25
CONFIG_WL_SECTOR_SIZE_512=y
CONFIG_WL_SECTOR_SIZE_4096=
CONFIG_WL_SECTOR_SIZE=512

# FATFS_LFN_STACK=y 
# FATFS_MAX_LFN=25
# FATFS_SECTOR_512=y
# FATFS_SECTOR_4096=
# FATFS_SECTOR_SIZE=512

#
# Compiler options
#
# CONFIG_COMPILER_OPTIMIZATION_DEFAULT is not set
CONFIG_COMPILER_OPTIMIZATION_SIZE=y
# CONFIG_COMPILER_OPTIMIZATION_PERF is not set
# CONFIG_COMPILER_OPTIMIZATION_NONE is not set
# CONFIG_COMPILER_OPTIMIZATION_ASSERTIONS_ENABLE is not set
CONFIG_COMPILER_OPTIMIZATION_ASSERTIONS_SILENT=y
# CONFIG_COMPILER_OPTIMIZATION_ASSERTIONS_DISABLE is not set
CONFIG_COMPILER_FLOAT_LIB_FROM_GCCLIB=y
CONFIG_COMPILER_OPTIMIZATION_ASSERTION_LEVEL=1
# CONFIG_COMPILER_OPTIMIZATION_CHECKS_SILENT is not set
CONFIG_COMPILER_HIDE_PATHS_MACROS=y
# CONFIG_COMPILER_CXX_EXCEPTIONS is not set
# CONFIG_COMPILER_CXX_RTTI is not set
CONFIG_COMPILER_STACK_CHECK_MODE_NONE=y
# CONFIG_COMPILER_STACK_CHECK_MODE_NORM is not set
# CONFIG_COMPILER_STACK_CHECK_MODE_STRONG is not set
# CONFIG_COMPILER_STACK_CHECK_MODE_ALL is not set
# CONFIG_COMPILER_WARN_WRITE_STRINGS is not set
# CONFIG_COMPILER_DUMP_RTL_FILES is not set
# end of Compiler options


# #
# # Wi-Fi
# #
# CONFIG_ESP32_WIFI_ENABLED=y
# CONFIG_ESP32_WIFI_STATIC_RX_BUFFER_NUM=10
# CONFIG_ESP32_WIFI_DYNAMIC_RX_BUFFER_NUM=32
# # CONFIG_ESP32_WIFI_STATIC_TX_BUFFER is not set
# CONFIG_ESP32_WIFI_DYNAMIC_TX_BUFFER=y
# CONFIG_ESP32_WIFI_TX_BUFFER_TYPE=1
# CONFIG_ESP32_WIFI_DYNAMIC_TX_BUFFER_NUM=32
# # CONFIG_ESP32_WIFI_CSI_ENABLED is not set
# CONFIG_ESP32_WIFI_AMPDU_TX_ENABLED=y
# CONFIG_ESP32_WIFI_TX_BA_WIN=6
# CONFIG_ESP32_WIFI_AMPDU_RX_ENABLED=y
# CONFIG_ESP32_WIFI_RX_BA_WIN=6
# CONFIG_ESP32_WIFI_NVS_ENABLED=y
# CONFIG_ESP32_WIFI_TASK_PINNED_TO_CORE_0=y
# # CONFIG_ESP32_WIFI_TASK_PINNED_TO_CORE_1 is not set
# CONFIG_ESP32_WIFI_SOFTAP_BEACON_MAX_LEN=752
# CONFIG_ESP32_WIFI_MGMT_SBUF_NUM=32
# CONFIG_ESP32_WIFI_IRAM_OPT=y
# CONFIG_ESP32_WIFI_RX_IRAM_OPT=y
# CONFIG_ESP32_WIFI_ENABLE_WPA3_SAE=y
# CONFIG_ESP32_WIFI_ENABLE_WPA3_OWE_STA=y
# # CONFIG_ESP_WIFI_SLP_IRAM_OPT is not set
# CONFIG_ESP_WIFI_STA_DISCONNECTED_PM_ENABLE=y
# # CONFIG_ESP_WIFI_GMAC_SUPPORT is not set
# CONFIG_ESP_WIFI_SOFTAP_SUPPORT=y
# # CONFIG_ESP_WIFI_SLP_BEACON_LOST_OPT is not set
# CONFIG_ESP_WIFI_ESPNOW_MAX_ENCRYPT_NUM=7
# # end of Wi-Fi


# # # Minimal WiFi/lwIP configuration
# # CONFIG_ESP32_WIFI_STATIC_RX_BUFFER_NUM=4
# # CONFIG_ESP32_WIFI_DYNAMIC_TX_BUFFER_NUM=16
# # CONFIG_ESP32_WIFI_DYNAMIC_RX_BUFFER_NUM=8
# # CONFIG_ESP32_WIFI_AMPDU_RX_ENABLED=
# # CONFIG_LWIP_TCPIP_RECVMBOX_SIZE=16
# # CONFIG_LWIP_TCP_SND_BUF_DEFAULT=6144
# # CONFIG_LWIP_TCP_WND_DEFAULT=6144
# # CONFIG_LWIP_TCP_RECVMBOX_SIZE=8
# # CONFIG_LWIP_UDP_RECVMBOX_SIZE=8
# # CONFIG_ESP32_WIFI_IRAM_OPT=y
# # CONFIG_ESP32_WIFI_RX_IRAM_OPT=y
# # CONFIG_LWIP_IRAM_OPTIMIZATION=y



#
# FreeRTOS
#
CONFIG_FREERTOS_UNICORE=y
# CONFIG_ESP_TASK_WDT=y
# CONFIG_ESP_TASK_WDT_PANIC=y
# CONFIG_ESP_TASK_WDT_TIMEOUT_S=2
# CONFIG_ESP_TASK_WDT_CHECK_IDLE_TASK_CPU0=y
# CONFIG_INT_WDT=
# CONFIG_TASK_WDT=
CONFIG_FREERTOS_USE_TRACE_FACILITY=y
CONFIG_FREERTOS_USE_STATS_FORMATTING_FUNCTIONS=y
CONFIG_FREERTOS_GENERATE_RUN_TIME_STATS=y
# CONFIG_SUPPORT_STATIC_ALLOCATION=y
# CONFIG_ENABLE_STATIC_TASK_CLEAN_UP_HOOK=y
# CONFIG_TIMER_TASK_STACK_DEPTH=3584
# CONFIG_TIMER_TASK_PRIORITY=5
# CONFIG_FREERTOS_LEGACY_HOOKS=y
# CONFIG_FREERTOS_LEGACY_IDLE_HOOK=y
# CONFIG_FREERTOS_LEGACY_TICK_HOOK=y


#
# Heap memory debugging
#
# # CONFIG_HEAP_POISONING_DISABLED is not set
# CONFIG_HEAP_POISONING_LIGHT=y
# # CONFIG_HEAP_POISONING_COMPREHENSIVE is not set
# CONFIG_HEAP_TRACING_OFF=n
# # CONFIG_HEAP_TRACING=y
# CONFIG_HEAP_TRACING_STANDALONE=y
# # CONFIG_HEAP_TRACING_TOHOST is not set
CONFIG_HEAP_TASK_TRACKING=y
# # CONFIG_HEAP_ABORT_WHEN_ALLOCATION_FAILS is not set
# # end of Heap memory debugging


# #
# # Port
# #
# # CONFIG_FREERTOS_WATCHPOINT_END_OF_STACK is not set
# CONFIG_FREERTOS_WATCHPOINT_END_OF_STACK = y
# CONFIG_FREERTOS_TLSP_DELETION_CALLBACKS=y
# # CONFIG_FREERTOS_ENABLE_STATIC_TASK_CLEAN_UP is not set
# CONFIG_FREERTOS_CHECK_MUTEX_GIVEN_BY_OWNER=y
# CONFIG_FREERTOS_ISR_STACKSIZE=1536
# CONFIG_FREERTOS_INTERRUPT_BACKTRACE=y
# # CONFIG_FREERTOS_FPU_IN_ISR is not set
# CONFIG_FREERTOS_TICK_SUPPORT_CORETIMER=y
# CONFIG_FREERTOS_CORETIMER_0=y
# # CONFIG_FREERTOS_CORETIMER_1 is not set
# CONFIG_FREERTOS_SYSTICK_USES_CCOUNT=y
# # CONFIG_FREERTOS_PLACE_FUNCTIONS_INTO_FLASH is not set
# # CONFIG_FREERTOS_PLACE_SNAPSHOT_FUNS_INTO_FLASH is not set
# # CONFIG_FREERTOS_CHECK_PORT_CRITICAL_COMPLIANCE is not set
# CONFIG_FREERTOS_ENABLE_TASK_SNAPSHOT=y
# # end of Port

# CONFIG_FREERTOS_NO_AFFINITY=0x7FFFFFFF
# CONFIG_FREERTOS_SUPPORT_STATIC_ALLOCATION=y
# CONFIG_FREERTOS_DEBUG_OCDAWARE=y
# # end of FreeRTOS

# #
# # Hardware Abstraction Layer (HAL) and Low Level (LL)
# #
# CONFIG_HAL_ASSERTION_EQUALS_SYSTEM=y
# # CONFIG_HAL_ASSERTION_DISABLE is not set
# # CONFIG_HAL_ASSERTION_SILENT is not set
# CONFIG_HAL_DEFAULT_ASSERTION_LEVEL=1
# # end of Hardware Abstraction Layer (HAL) and Low Level (LL)


# #
# # Serial flasher config
# #
# # CONFIG_ESPTOOLPY_BEFORE_NORESET=y
# # CONFIG_ESPTOOLPY_BEFORE="no_reset"
# # CONFIG_ESPTOOLPY_BEFORE="no_reset_no_sync"
# CONFIG_ESPTOOLPY_BEFORE_RESET=n
# # CONFIG_ESPTOOLPY_BEFORE="default_reset"


#
# AWS OTA
#
#CONFIG_LOG2_FILE_BLOCK_SIZE = 10: 1kB
#CONFIG_LOG2_FILE_BLOCK_SIZE = 11: 2kB
#CONFIG_LOG2_FILE_BLOCK_SIZE = 12: 4kB
CONFIG_LOG2_FILE_BLOCK_SIZE=12
CONFIG_MAX_NUM_BLOCKS_REQUEST=8
CONFIG_MAX_NUM_OTA_DATA_BUFFERS=10
CONFIG_ALLOW_DOWNGRADE=1
CONFIG_OTA_DATA_OVER_MQTT=y
CONFIG_OTA_DATA_OVER_HTTP=y
CONFIG_OTA_DATA_OVER_MQTT_PRIMARY=y
CONFIG_OTA_PRIMARY_DATA_PROTOCOL=1


# #
# # corePKCS11 Logging
# #
# # CONFIG_CORE_PKCS_LOG_ERROR is not set
# CONFIG_CORE_PKCS_LOG_WARN=y
# # CONFIG_CORE_PKCS_LOG_INFO is not set
# # CONFIG_CORE_PKCS_LOG_DEBUG is not set
# # end of Logging
# # end of corePKCS11



# # CONFIG_OPTIMIZATION_LEVEL_DEBUG is not set
# # CONFIG_COMPILER_OPTIMIZATION_LEVEL_DEBUG is not set
# CONFIG_OPTIMIZATION_LEVEL_RELEASE=y
# CONFIG_COMPILER_OPTIMIZATION_LEVEL_RELEASE=y
# # CONFIG_OPTIMIZATION_ASSERTIONS_ENABLED is not set
# CONFIG_OPTIMIZATION_ASSERTIONS_SILENT=y
# # CONFIG_OPTIMIZATION_ASSERTIONS_DISABLED is not set
# CONFIG_OPTIMIZATION_ASSERTION_LEVEL=1
# # CONFIG_CXX_EXCEPTIONS is not set
```

## sdkconfig.defaults.esp32
```kconfig
### changed by Marcus A. P. Oliveira

CONFIG_ESP_SLEEP_DEBUG=y


#
# The Things Network
#
# CONFIG_TTN_LORA_FREQ_DISABLED is not set
# CONFIG_TTN_LORA_FREQ_EU_868 is not set
CONFIG_TTN_LORA_FREQ_US_915=y
# CONFIG_TTN_LORA_FREQ_AU_915 is not set
# CONFIG_TTN_LORA_FREQ_AS_923 is not set
# CONFIG_TTN_LORA_FREQ_AS_923_JP is not set
# CONFIG_TTN_LORA_FREQ_KR_920 is not set
# CONFIG_TTN_LORA_FREQ_IN_866 is not set
# CONFIG_TTN_RADIO_SX1272_73 is not set
CONFIG_TTN_RADIO_SX1276_77_78_79=y
CONFIG_TTN_SPI_FREQ=1000000
CONFIG_TTN_RESET_STATES_FLOATING=n
# CONFIG_TTN_RESET_STATES_ASSERTED is not set
CONFIG_TTN_BG_TASK_PRIO=10
CONFIG_TTN_PROVISION_UART_DEFAULT=y
# CONFIG_TTN_PROVISION_UART_CUSTOM is not set
# CONFIG_TTN_PROVISION_UART_NONE is not set
CONFIG_TTN_PROVISION_UART_NUM=0
# end of The Things Network
```

## sdkconfig.defaults.esp32s2
```kconfig
CONFIG_SPIRAM=y
CONFIG_SPIRAM_ALLOW_BSS_SEG_EXTERNAL_MEMORY=y
CONFIG_SPIRAM_ALLOW_NOINIT_SEG_EXTERNAL_MEMORY=y
CONFIG_SPIRAM_BOOT_INIT=y
CONFIG_SPIRAM_MEMTEST=y
CONFIG_SPIRAM_USE_MALLOC=y

CONFIG_IDF_TARGET="esp32s2"
CONFIG_IDF_TARGET_ESP32=n
CONFIG_IDF_TARGET_ESP32S2=y
```

## sdkconfig.defaults.esp32s3
```kconfig
CONFIG_SPIRAM=y
CONFIG_SPIRAM_USE_MEMMAP=y
CONFIG_SPIRAM_ALLOW_BSS_SEG_EXTERNAL_MEMORY=y
CONFIG_SPIRAM_ALLOW_NOINIT_SEG_EXTERNAL_MEMORY=y
CONFIG_SPIRAM_ALLOW_STACK_EXTERNAL_MEMORY=y
CONFIG_SPIRAM_BOOT_INIT=y
CONFIG_SPIRAM_MEMTEST=y
CONFIG_SPIRAM_USE_MALLOC=y
CONFIG_SPIRAM_USE_CAPS_ALLOC=y

CONFIG_IDF_TARGET="esp32s3"
CONFIG_IDF_TARGET_ESP32=n
CONFIG_IDF_TARGET_ESP32S3=y
```
